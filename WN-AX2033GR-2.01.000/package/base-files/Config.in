## WN-AX2033GR-2.01.000/package/base-files/Config.in
```kconfig
if PACKAGE_base-files
		menu"MSTC Dual Image with Persist Partition"
 		config MSTC_DUAL_IMAGE_WITH_PERSIST
 		bool "MSTC Dual Image Support with Persist Partition"
 		default n

		endmenu
endif
```

## WN-AX2033GR-2.01.000/package/network/services/miniupnpd/Config.in
```kconfig
	
config MINIUPNPD_VENDORCFG
	bool "Enable all manufacturer infos through miniupnpd.conf"
	default n
	help
	  Enable all manufacturer infos through miniupnpd.conf

config MINIUPNPD_PCP_PEER
	bool "Disable PCP PEER operation"
	default n
	help
	  Disable PCP PEER operation
	  
config MINIUPNPD_PORTINUSE
	bool "Enable port in use check"
	default n
	help
	  Enable port in use check
	  
config MINIUPNPD_STRICT
	bool "Enable more strict about UPnP conformance and the messages"
	default y
	help
		Enable to make MiniUPnPd more strict about UPnP conformance
		and the messages it receives from control points

config MINIUPNPD_IPV6
	bool "Enable MiniUPnPd to support IPv6"
	default y
	depends on IPV6
	help
		Enable MiniUPnPd to support IPv6

config MINIUPNPD_EXEC_IN_WAN_GET_IP
	bool "miniupnpd execute only if wan interface get IP address"
	default y
	help
	  miniupnpd application execute only if wan interface get IP address
	  y : execute only if wan interface get IP address
	  n : execute no matter wan interface get IP address
```

## WN-AX2033GR-2.01.000/package/ramips/applications/switch/Config.in
```kconfig
if PACKAGE_switch
if TARGET_ramips_mt7621
choice
	prompt "LAN/WAN port setting"

	config PACKAGE_switch_LLLLW
	bool "LLLLW"
	default y

	config PACKAGE_switch_WLLLL
	bool "WLLLL"
endchoice
endif
endif
```

## WN-AX2033GR-2.01.000/package/ramips/drivers/mt7615e/config.in
```kconfig
if PACKAGE_kmod-mt7615e

config MT7615E_AP_SUPPORT
    bool
    default y
    depends on PACKAGE_kmod-mt7615e

config MT7615E_SUPPORT_OPENWRT
    bool
    default y
    depends on PACKAGE_kmod-mt7615e

config MT7615E_RT_FIRST_CARD
    string
    default 7615e
    depends on PACKAGE_kmod-mt7615e

config MT7615E_RT_SECOND_CARD
    string
    default 7615e
    depends on PACKAGE_kmod-mt7615e

config MT7615E_RT_FIRST_IF_RF_OFFSET
    hex
    default 0x0

config MT7615E_RT_SECOND_IF_RF_OFFSET
    hex
    default 0x8000 

choice
	prompt "choose First IF"
	depends on PACKAGE_kmod-mt7615e

	config MT7615E_FIRST_IF_MT7615E
	bool "MT7615E at First IF"
	default y

	config MT7615E_FIRST_IF_MT7603E
	bool "MT7603E at First IF"

	config MT7615E_FIRST_IF_NONE
	bool "No Card at First IF"
endchoice

choice
	prompt "choose Second IF"
	depends on PACKAGE_kmod-mt7615e

	config MT7615E_SECOND_IF_MT7615E
	bool "MT7615E at Second IF"
	default y

	config MT7615E_SECOND_IF_MT7603E
	bool "MT7603E at Second IF"

	config MT7615E_SECOND_IF_NONE
	bool "No Card at Second IF"
endchoice

config MT7615E_WIFI_DRIVER
    bool
    default y
    depends on PACKAGE_kmod-mt7615e
    select MT7615E_WIFI_MT_MAC
    select MT7615E_MT_MAC
    select MT7615E_CHIP_MT7615E

config MT7615E_MT_WIFI
	tristate "MT WIFI Driver"
	default y
	select MT7615E_WIFI_BASIC_FUNC if MT7615E_MT_WIFI

config MT7615E_MT_WIFI_PATH
	string
	depends on MT7615E_MT_WIFI
	default "mt_wifi"

if MT7615E_MT_WIFI
menu "WiFi Generic Feature Options"
choice
	prompt "EEPROM Type of 1st Card"
	depends on ! MT7615E_FIRST_IF_NONE

	config MT7615E_FIRST_IF_EEPROM_FLASH
	bool "FLASH"

	config MT7615E_RIRST_IF_EEPROM_EFUSE
	bool "EFUSE"
endchoice

config MT7615E_RT_FIRST_CARD_EEPROM
	string
	depends on ! MT7615E_FIRST_IF_NONE
	default "flash" if MT7615E_FIRST_IF_EEPROM_FLASH

choice
	prompt "EEPROM Type of 2nd Card"
	depends on ! MT7615E_SECOND_IF_NONE

	config MT7615E_SECOND_IF_EEPROM_FLASH
	bool "FLASH"

	config MT7615E_SECOND_IF_EEPROM_PROM
	bool "EEPROM"

	config MT7615E_SECOND_IF_EEPROM_EFUSE
	bool "EFUSE"
endchoice

config MT7615E_RT_SECOND_CARD_EEPROM
	string
	depends on ! MT7615E_SECOND_IF_NONE
	default "prom" if MT7615E_SECOND_IF_EEPROM_PROM
	default "efuse" if MT7615E_SECOND_IF_EEPROM_EFUSE
	default "flash" if MT7615E_SECOND_IF_EEPROM_FLASH
		
config MT7615E_MULTI_INF_SUPPORT
	bool
	default y if !MT7615E_FIRST_IF_NONE && !MT7615E_SECOND_IF_NONE
		
config MT7615E_WIFI_BASIC_FUNC
	bool "Basic Functions"
	select MT7615E_WIRELESS_EXT
	select MT7615E_WEXT_SPY
	select MT7615E_WEXT_PRIV

config MT7615E_DOT11_N_SUPPORT
	bool "802.11n support"
	default y

config MT7615E_DOT11_VHT_AC
	bool "802.11AC support"
	depends on MT7615E_WIFI_DRIVER
	depends on MT7615E_DOT11_N_SUPPORT
	default y

config MT7615E_G_BAND_256QAM_SUPPORT
	bool "2.4G 256QAM support"
	depends on MT7615E_WIFI_DRIVER
    	depends on MT7615E_DOT11_VHT_AC
	default y

config MT7615E_BRCM_256QAM_SUPPORT
	bool "BRCM 2.4G 256QAM support"
	depends on MT7615E_WIFI_DRIVER
	depends on MT7615E_G_BAND_256QAM_SUPPORT
	default y

config MT7615E_TPC_SUPPORT
	bool "802.11h TPC Support"
	depends on MT7615E_WIFI_DRIVER
	default y
	
config MT7615E_ICAP_SUPPORT
	bool "ICAP Support"
	depends on MT7615E_WIFI_DRIVER
	depends on MT7615E_MT_AP_SUPPORT
	default y

config MT7615E_BACKGROUND_SCAN_SUPPORT
	bool "Background Scan Support"
	depends on MT7615E_WIFI_DRIVER
	default y
	
config MT7615E_SMART_CARRIER_SENSE_SUPPORT
	bool "Smart Carrier Sense Support"
	depends on MT7615E_WIFI_DRIVER
	default y
	
config MT7615E_MT_DFS_SUPPORT
        bool "Dynamic Frequency Selection Support"	
        depends on MT7615E_WIFI_DRIVER
        default y

#config WFA_VHT_R2_PF
#    bool "WFA VHT R2 Plugfest"
#    depends on DOT11_VHT_AC
#    default n

config MT7615E_HDR_TRANS_TX_SUPPORT
    bool "Tx Header Translation"
    depends on MT7615E_CHIP_MT7615E
    default y

config MT7615E_HDR_TRANS_RX_SUPPORT
    bool "Rx Header Translation"
    depends on MT7615E_CHIP_MT7615E
    default y

config MT7615E_DBDC_MODE
	bool "dbdc mode support"
	default y

config MT7615E_SUPPORT_DYNAMIC_TXOP
    	bool "dynamic txop support"
	default n
        
config MT7615E_WSC_INCLUDED
	bool "WSC (WiFi Simple Config)"
	depends on MT7615E_WIFI_DRIVER
	depends on MT7615E_MT_AP_SUPPORT || MT7615E_MT_STA_SUPPORT
	default y

config MT7615E_WSC_V2_SUPPORT
	bool "WSC V2(WiFi Simple Config Version 2.0)"
	depends on MT7615E_WIFI_DRIVER
	depends on MT7615E_MT_AP_SUPPORT || MT7615E_MT_STA_SUPPORT
	default y
	
config MT7615E_MSTC_ENABLE_APCLI_WEP_IN_WSC_V2
	bool "MSTC Support apcli can link to wep wps in WSC V2"
	depends on MT7615E_WSC_V2_SUPPORT
    default n
	
config MT7615E_MSTC_CALL_MSTC_WPS_UTIL_IN_WSC_ENROLLE_PIN_METHOD
	bool "MSTC call mstc_wps_util when ap is enrolle and running pin method"
	depends on MT7615E_WSC_INCLUDED
    default n
	
config MT7615E_MSTC_FIRST_BSSID_IN_FLASH_AS_UUID
	bool "MSTC Use first Wireless MAC in flash as WSC UUID"
	depends on MT7615E_WSC_INCLUDED
	depends on MT7615E_RTMP_FLASH_SUPPORT
	default y
	
config MT7615E_MSTC_WSC_EXTRA_PROFILE_SUPPORT
	bool "MSTC WSC Support extra credential in the message M8"
	depends on MT7615E_WSC_INCLUDED
	default n
	
config MT7615E_MSTC_WSC_EXTRA_PROFILE_DAT_PATH
	string "MSTC WSC EXTRA PROFILE DAT PATH"
	depends on MT7615E_WSC_INCLUDED
	depends on MT7615E_MSTC_WSC_EXTRA_PROFILE_SUPPORT
	default "/etc/wireless/mt7603e/mt7603e.dat"

config MT7615E_DOT11W_PMF_SUPPORT
	bool "PMF"
	depends on MT7615E_WIFI_DRIVER
	depends on MT7615E_MT_AP_SUPPORT
	default y

config MT7615E_TXBF_SUPPORT
        bool "Tx Bean Forming Support"
        depends on MT7615E_WIFI_DRIVER
        default n

#config LLTD_SUPPORT
#	bool "LLTD (Link Layer Topology Discovery Protocol)"
#	depends on WIFI_DRIVER
#	depends on MT_AP_SUPPORT
#	default n

#config QOS_DLS_SUPPORT
#	bool "802.11e DLS ((Direct-Link Setup) Support"
#	depends on WIFI_DRIVER
#	depends on MT_AP_SUPPORT
#	default n

#config WAPI_SUPPORT
#	bool "WAPI Support"
#	depends on WIFI_DRIVER
#	default n

#config FTM_SUPPORT
#	bool "FTM Support"
#	depends on WIFI_DRIVER
#	select PASSPOINT_R2
#	default n

#config CARRIER_DETECTION_SUPPORT
#	bool "Carrier Detect"
#	depends on WIFI_DRIVER
#	default n

config MT7615E_IGMP_SNOOP_SUPPORT
	bool "IGMP snooping"
	depends on MT7615E_WIFI_DRIVER
	depends on MT7615E_MT_AP_SUPPORT
	default y

#config BLOCK_NET_IF
#	bool "NETIF Block"
#	depends on WIFI_DRIVER
#	depends on MT_AP_SUPPORT
#	default n
#	help
#	Support Net interface block while Tx-Sw queue full

config MT7615E_RATE_ADAPTION
	bool "New Rate Adaptation support"
	depends on MT7615E_WIFI_DRIVER
	default y

#config NEW_RATE_ADAPT_SUPPORT
#	bool "Intelligent Rate Adaption"
#	depends on WIFI_DRIVER && RATE_ADAPTION
#	default y

#config AGS_SUPPORT
#	bool "Adaptive Group Switching"
#	depends on WIFI_DRIVER && RATE_ADAPTION
#	depends on MT_AP_SUPPORT || MT_STA_SUPPORT
#	default n

config MT7615E_RATE_ADAPT_AGBS_SUPPORT
	bool "Adaptive AGBS Mode"
	depends on MT7615E_WIFI_DRIVER && MT7615E_RATE_ADAPTION
	depends on MT7615E_MT_AP_SUPPORT || MT7615E_MT_STA_SUPPORT
	default y

#config IDS_SUPPORT
#	bool "IDS (Intrusion Detection System) Support"
#	depends on WIFI_DRIVER
#	depends on MT_AP_SUPPORT
#	default n

#config WIFI_WORK_QUEUE
#	bool "Work Queue"
#	depends on WIFI_DRIVER
#	default n

#config WIFI_SKB_RECYCLE
#	bool "SKB Recycle(Linux)"
#	depends on WIFI_DRIVER
#	depends on MT_AP_SUPPORT
#	default n

config MT7615E_RTMP_FLASH_SUPPORT
	bool "Flash Support"
	depends on MT7615E_WIFI_DRIVER
	default y

#config MT7615E_CAL_TO_FLASH_SUPPORT
#	bool "Calibration To Flash/BinFile Support"
#	depends on MT7615E_WIFI_DRIVER
#	depends on MT7615E_RTMP_FLASH_SUPPORT
#	default y
    
config MT7615E_RLM_CAL_CACHE_SUPPORT
	bool "RlmCalibrationCache Support"
	depends on MT7615E_WIFI_DRIVER
	default n

config MT7615E_PRE_CAL_FLASH_SUPPORT
	bool "Pre-calibration to Flash Support"
	depends on MT7615E_WIFI_DRIVER
	depends on MT7615E_RTMP_FLASH_SUPPORT
	default n

config MT7615E_CAL_BIN_FILE_SUPPORT
	bool "Calibration to BinFile Support"
	depends on MT7615E_WIFI_DRIVER
	default y

config MT7615E_RF_LOCKDOWN_SUPPORT
	bool "RF Lockdown Support"
	depends on MT7615E_WIFI_DRIVER
	default n
	
#config LED_CONTROL_SUPPORT
#	bool "LED Support"
#	depends on WIFI_DRIVER
#	depends on MT_AP_SUPPORT
#	default n

config MT7615E_ATE_SUPPORT
	bool "ATE/QA Support"
	depends on MT7615E_WIFI_DRIVER
	depends on MT7615E_MT_AP_SUPPORT
	default n	

#config MEMORY_OPTIMIZATION
#	bool "Memory Optimization"
#	depends on WIFI_DRIVER
#	default n

#config PASSPOINT_R2
#	bool "Passpoint Release-2 Support"
#	depends on WIFI_DRIVER
#	select DOT11W_PMF_SUPPORT
#	depends on MT_AP_SUPPORT
#	default n

#config TRACE_TCP_PKT
#       bool "TCP DATA/ACK packets trace log"
#       depends on WIFI_DRIVER
#       default n

config MT7615E_UAPSD
	bool "UAPSD support"
	depends on MT7615E_WIFI_DRIVER
	depends on MT7615E_MT_AP_SUPPORT || MT7615E_MT_STA_SUPPORT
	default y

#config TCP_RACK_SUPPORT
#	bool "TCP Reduced ACK  support"
#	depends on WIFI_DRIVER
#	default n

config MT7615E_RED_SUPPORT
	bool "RED(Random Early Drop) support"
	depends on MT7615E_WIFI_DRIVER
	depends on MT7615E_MT_AP_SUPPORT || MT7615E_MT_STA_SUPPORT
	default y

config MT7615E_FDB_SUPPORT
	bool "FW Debug Port"
	depends on MT7615E_WIFI_DRIVER
	default n
       
#
# Section for chip architectures
#
# "RLT MAC Support"
config MT7615E_RLT_MAC
	bool
	depends on MT7615E_WIFI_DRIVER
	default n

config MT7615E_RLT_BBP
	bool

config MT7615E_RLT_RF
	bool

# "RTMP MAC Support"
config MT7615E_RTMP_MAC
	bool
	depends on WIFI_DRIVER
	default n

config MT7615E_RTMP_BBP
    	bool

config MT7615E_RTMP_RF
    	bool

#
# Section for interfaces
#
config MT7615E_RTMP_PCI_SUPPORT
    	bool

config MT7615E_RTMP_USB_SUPPORT
		bool

config MT7615E_RTMP_RBUS_SUPPORT
    	bool

endmenu

menu "WiFi Operation Modes"
choice
	prompt "Main Mode"
	default MT7615E_WIFI_MODE_AP

	config MT7615E_WIFI_MODE_AP
		bool "AP"
		select MT7615E_MT_AP_SUPPORT

	config MT7615E_WIFI_MODE_STA
		bool "STA"
		select MT7615E_MT_STA_SUPPORT

	config MT7615E_WIFI_MODE_BOTH
		bool "APSTA"
		select MT7615E_MT_AP_SUPPORT
		select MT7615E_MT_STA_SUPPORT
endchoice

# if MT7615E_WIFI_MODE_AP || MT7615E_WIFI_MODE_BOTH
#	source "config.ap"
# endif

####################ap

config MT7615E_MT_AP_SUPPORT
	tristate "Ralink RT2860 802.11n AP support"
#	depends on NET_RADIO 
	select MT7615E_WIRELESS_EXT
	select MT7615E_WEXT_SPY
	select MT7615E_WEXT_PRIV

config MT7615E_WDS_SUPPORT
	bool "WDS"
	depends on MT7615E_MT_AP_SUPPORT
	default n

config MT7615E_MBSS_SUPPORT
	bool "MBSSID"
	depends on MT7615E_MT_AP_SUPPORT
	default y

#config MT7615E_NEW_MBSSID_MODE
#	bool "New MBSSID MODE"
#	depends on MT_AP_SUPPORT && MBSS_SUPPORT
#	depends on RALINK_RT3883 || RALINK_RT3352 || RALINK_RT5350 || RALINK_RT6352 || RALINK_MT7620
#	default y

#config ENHANCE_NEW_MBSSID_MODE
#	bool "Enhanced MBSSID mode"
#	depends on NEW_MBSSID_MODE
#	default y

config MT7615E_APCLI_SUPPORT
	bool "AP-Client Support"
	depends on MT7615E_MT_AP_SUPPORT
	default y

config MT7615E_APCLI_CERT_SUPPORT
        bool "AP-Client TGn Cert Support"
	depends on MT7615E_MT_AP_SUPPORT
        depends on MT7615E_APCLI_SUPPORT
        default n

config MT7615E_MAC_REPEATER_SUPPORT
	bool "MAC Repeater Support"
	depends on MT7615E_MT_AP_SUPPORT
	depends on MT7615E_APCLI_SUPPORT
	depends on MT7615E_RALINK_RT6352 || MT7615E_RALINK_MT7620 || MT7615E_RALINK_MT7603E || MT7615E_MT_AP_SUPPORT
	default y

#config DOT11R_FT_SUPPORT
#	bool "802.11r Fast BSS Transition"
#	depends on MT_AP_SUPPORT

#config DOT11K_RRM_SUPPORT
#	bool "802.11k Radio Resource Management"
#	depends on MT_AP_SUPPORT

#config SNIFFER_SUPPORT
#	bool "SNIFFER"
#	depends on MT_AP_SUPPORT
#	default n

config MT7615E_CFG80211_SUPPORT
	bool "CFG80211"
	depends on MT7615E_MT_AP_SUPPORT
	default n

config MT7615E_CON_WPS_SUPPORT
	bool "Concurrent WPS Support"
	depends on MT7615E_MT_AP_SUPPORT
	depends on MT7615E_APCLI_SUPPORT
	depends on MT7615E_WSC_INCLUDED
	depends on MT7615E_WSC_V2_SUPPORT
	default y
	
#config LLTD_SUPPORT
#	bool "LLTD (Link Layer Topology Discovery Protocol)"
#	depends on MT_AP_SUPPORT

#config COC_SUPPORT
#	bool "CoC Support"
#	depends on MT_AP_SUPPORT
#	default n

#config  RT2860V2_SNMP
#	bool "Net-SNMP Support"
#	depends on MT_AP_SUPPORT

config MT7615E_MCAST_RATE_SPECIFIC
	bool "User specific tx rate of mcast pkt"
	depends on MT7615E_MT_AP_SUPPORT
	default y

#config EXT_BUILD_CHANNEL_LIST
#	bool "Extension Channel List"
#	depends on MT_AP_SUPPORT

#config AUTO_CH_SELECT_ENHANCE
#	bool "Auto Channel Selection Enhancement"
#	depends on MT_AP_SUPPORT

config MT7615E_VOW_SUPPORT
	bool "MediaAir(VOW) support"
	depends on MT7615E_MT_AP_SUPPORT
	default y

#config AIRPLAY_SUPPORT
#	bool "AIRPLAY Support"
#	depends on MT_AP_SUPPORT
#	default n

config MT7615E_BAND_STEERING
	bool "Band Steering"
	depends on MT7615E_MT_AP_SUPPORT
	default n

config MT7615E_MUMIMO_SUPPORT
        bool "MU-MIMO Support"
        depends on MT7615E_MT_AP_SUPPORT
        default y

config MT7615E_SER_SUPPORT
        bool "SER Support"
        depends on MT7615E_WIFI_DRIVER
        default y

config MT7615E_MU_RA_SUPPORT
  	bool "MU-RGA Support"
  	depends on MT7615E_MUMIMO_SUPPORT
  	default y

config MT7615E_TXOP_ARBITER
        bool "TXOP_ARBITER Support"
        depends on MT7615E_MT_AP_SUPPORT
        default y
        
config MT7615E_CFG_SUPPORT_DYNAMIC_TXOP
        bool "DYNAMIC_TXOP Support"
        depends on MT7615E_TXOP_ARBITER
        default y	

config MT7615E_LED_CONTROL_SUPPORT
        bool "LED Control Support"
        default y

endmenu	

endif

if MT7615E_WIFI_RLT_MAC
	config MT7615E_RLT_MAC
	bool
	default y
endif

if MT7615E_WIFI_RTMP_MAC
	config MT7615E_RTMP_MAC
	bool
	default y
endif

if MT7615E_WIFI_MT_MAC
	config MT7615E_MT_MAC
	bool
	default y

	config MT7615E_CHIP_MT7603E
	bool
		default n

	config MT7615E_CHIP_MT7615E
	bool
	default n
endif

if MT7615E_CHIP_MT7615E
	config MT7615E_MT_MAC
		bool
		default y
		select MT7615E_RATE_ADAPTION
		select MT7615E_RATE_ADAPT_AGBS_SUPPORT
		select MT7615E_DOT11_N_SUPPORT
		select MT7615E_DOT11_VHT_AC
		select MT7615E_HDR_TRANS_TX_SUPPORT
		select MT7615E_HDR_TRANS_RX_SUPPORT
endif	

endif
```
